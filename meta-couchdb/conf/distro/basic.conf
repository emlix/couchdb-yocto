## meta-couchdb/conf/distro/basic.conf
```bitbake
require conf/distro/poky.conf

DISTRO = "basic"
DISTRO_NAME = "basic system"

PREFERRED_PROVIDER_virtual/kernel = "linux-minimal"

VIRTUAL-RUNTIME_init_manager = "busybox"
DISTRO_FEATURES_BACKFILL_CONSIDERED += "sysvinit"

NO_RECOMMENDATIONS = "1"

DISTRO_FEATURES = ""
DISTRO_FEATURES_NATIVESDK = ""
```

## meta-couchdb/conf/layer.conf
```bitbake
# We have a conf and classes directory, add to BBPATH
BBPATH .= ":${LAYERDIR}"

# We have recipes-* directories, add to BBFILES
BBFILES += "${LAYERDIR}/recipes-*/*/*.bb \
            ${LAYERDIR}/recipes-*/*/*.bbappend"

BBFILE_COLLECTIONS += "meta-couchdb"
BBFILE_PATTERN_meta-couchdb = "^${LAYERDIR}/"
BBFILE_PRIORITY_meta-couchdb = "6"

LAYERDEPENDS_meta-couchdb = "core"
LAYERSERIES_COMPAT_meta-couchdb = "dunfell"
```

## meta-couchdb/conf/machine/qemux86-64-test.conf
```bitbake
#@TYPE: Machine
#@NAME: Test
#@DESCRIPTION: Machine configuration for testing

DEFAULTTUNE ?= "corei7-64"
require conf/machine/include/tune-corei7.inc

PREFERRED_PROVIDER_virtual/kernel = "linux-minimal"

KERNEL_IMAGETYPE = "bzImage"

SERIAL_CONSOLES ?= "115200;ttyS0"

# QEMU config
IMAGE_CLASSES += "qemuboot"
EXTRA_IMAGEDEPENDS += "qemu-native qemu-helper-native"

QB_SYSTEM_NAME = "qemu-system-x86_64"
QB_MEM = "1024"
QB_NET = "none"
QB_OPT_APPEND = ""
```
